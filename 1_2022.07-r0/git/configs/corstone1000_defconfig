## 1_2022.07-r0/git/configs/corstone1000_defconfig
```kconfig
CONFIG_ARM=y
CONFIG_TARGET_CORSTONE1000=y
CONFIG_SYS_TEXT_BASE=0x80000000
CONFIG_SYS_MALLOC_F_LEN=0x2000
CONFIG_SYS_MALLOC_LEN=0x2000000
CONFIG_SYS_LOAD_ADDR=0x82100000
CONFIG_NR_DRAM_BANKS=1
CONFIG_IDENT_STRING=" corstone1000 aarch64 "
CONFIG_FIT=y
CONFIG_BOOTDELAY=3
CONFIG_USE_BOOTARGS=y
CONFIG_BOOTARGS="console=ttyAMA0 loglevel=9 ip=dhcp earlyprintk"
CONFIG_LOGLEVEL=7
# CONFIG_DISPLAY_CPUINFO is not set
# CONFIG_DISPLAY_BOARDINFO is not set
CONFIG_HUSH_PARSER=y
CONFIG_SYS_PROMPT="corstone1000# "
# CONFIG_CMD_CONSOLE is not set
CONFIG_CMD_BOOTZ=y
CONFIG_CMD_BOOTM=y
CONFIG_CMD_LOADM=y
CONFIG_CMD_BOOTEFI=y
CONFIG_EFI_LOADER=y
CONFIG_EFI_PARTITION=y
CONFIG_CMD_BOOTEFI_HELLO_COMPILE=y
CONFIG_CMD_BOOTEFI_HELLO=y
# CONFIG_CMD_XIMG is not set
# CONFIG_CMD_ENV_EXISTS is not set
CONFIG_CMD_NVEDIT_EFI=y
# CONFIG_CMD_LOADS is not set
CONFIG_CMD_USB=y
CONFIG_CMD_ITEST=y
# CONFIG_CMD_SETEXPR is not set
# CONFIG_CMD_NFS is not set
CONFIG_CMD_MII=y
CONFIG_CMD_CACHE=y
CONFIG_CMD_EFIDEBUG=y
CONFIG_CMD_FAT=y
CONFIG_OF_CONTROL=y
CONFIG_REGMAP=y
CONFIG_CLK=y
CONFIG_CMD_MMC=y
CONFIG_DM_MMC=y
CONFIG_ARM_PL180_MMCI=y
CONFIG_MMC_SDHCI_ADMA_HELPERS=y
CONFIG_MMC_WRITE=y
CONFIG_DM_GPIO=y
CONFIG_DM_SERIAL=y
CONFIG_USB=y
CONFIG_DM_USB=y
CONFIG_USB_ISP1760=y
CONFIG_USB_STORAGE=y
CONFIG_ARM_FFA_TRANSPORT=y
CONFIG_ARM_FFA_EFI_RUNTIME_MODE=y
CONFIG_EFI_MM_COMM_TEE=y
# CONFIG_OPTEE is not set
# CONFIG_GENERATE_SMBIOS_TABLE is not set
# CONFIG_HEXDUMP is not set
CONFIG_EFI_RUNTIME_UPDATE_CAPSULE=y
CONFIG_EFI_CAPSULE_ON_DISK=y
# CONFIG_EFI_CAPSULE_ON_DISK_EARLY is not set
# CONFIG_EFI_CAPSULE_AUTHENTICATE is not set
CONFIG_EFI_HAVE_CAPSULE_SUPPORT=y
CONFIG_EFI_CAPSULE_FIRMWARE_FIT=y
CONFIG_EFI_CAPSULE_FIRMWARE_RAW=y
CONFIG_EFI_SECURE_BOOT=y
CONFIG_DM_RTC=y
CONFIG_CMD_RTC=y
CONFIG_EFI_GET_TIME=y
CONFIG_EFI_SET_TIME=y
CONFIG_RTC_EMULATION=y
CONFIG_PSCI_RESET=y
CONFIG_DISTRO_DEFAULTS=y
CONFIG_CMD_DHCP=y
CONFIG_SMC911X=y
CONFIG_SMC911X_BASE=0x40100000
CONFIG_DM_ETH=y
CONFIG_PHY_SMSC=y
CONFIG_CMD_BOOTEFI_SELFTEST=y
CONFIG_CMD_TIME=y
CONFIG_CMD_GETTIME=y
CONFIG_NET_RANDOM_ETHADDR=y
CONFIG_VERSION_VARIABLE=y
CONFIG_PHYLIB=y
CONFIG_PHY=y
CONFIG_RAM=y
CONFIG_ERRNO_STR=y
CONFIG_CMD_EDITENV=y
CONFIG_MISC=y
```

## 1_2022.07-r0/git/drivers/firmware/arm-ffa/Kconfig
```kconfig
# SPDX-License-Identifier: GPL-2.0

config ARM_FFA_TRANSPORT
	bool "Enable Arm Firmware Framework for Armv8-A driver"
	depends on DM && (ARM64 || SANDBOX)
	select ARM_SMCCC if !SANDBOX
	select CMD_ARMFFA
	select LIB_UUID
	select DEVRES
	help
	  The Firmware Framework for Arm A-profile processors (FF-A)
	  describes interfaces (ABIs) that standardize communication
	  between the Secure World and Normal World leveraging TrustZone
	  technology.

	  This driver is based on FF-A specification v1.0 and uses SMC32
	  calling convention.

	  FF-A specification:

	  https://developer.arm.com/documentation/den0077/a/?lang=en

	  In u-boot FF-A design, FF-A is considered as a discoverable bus.
	  The Secure World is considered as one entity to communicate with
	  using the FF-A bus.
	  FF-A communication is handled by one device and one instance (the bus).
	  This FF-A driver takes care of all the interactions between Normal world
	  and Secure World.

	  For more details about the FF-A driver, please refer to doc/README.ffa.drv

config ARM_FFA_EFI_RUNTIME_MODE
	bool "Enable EFI runtime support for FF-A data and code"
	depends on ARM_FFA_TRANSPORT && EFI_LOADER
	help
	  Allows FF-A driver data structures and code to be accessible at EFI runtime.
	  FF-A data is copied by ffa_copy_runtime_data function.
	  The driver Code needed at runtime is placed at EFI runtime code section.
	  Turning this on makes ffa_copy_runtime_data available for use and the driver
	  code placed at EFI runtime code section.

config SANDBOX_FFA
	bool "FF-A Sandbox driver"
	depends on ARM_FFA_TRANSPORT && SANDBOX
	help
	  This emulates the FF-A handling under Sandbox and allows to test the FF-A driver
```
